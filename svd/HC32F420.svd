# XHSC_HC32F420 register map
Vendor: XHSC Co.Ltd; Series: ARMCM4; File version: 1.2
CPU: CM4 r0p0, little endian, no MPU, no FPU, 3 interrupt priority bits
Registers are 32-bit, read-write, reset 0x0 unless marked. A register's access mark holds for its fields unless they carry their own. Offsets are from the block's base; lines under a group give offsets from that group; [hi:lo] are bit positions; {n}, {i} and the like mark numbered series; 'fields as' and 'values as' point back to an identical list; <NAME> marks a mode.

## Memory map
0x40000000 USART0 size 0xF4 — desc USART
0x40000400 USART1 size 0xF4 — desc USART
0x40000800 USART2 size 0xF4 — desc USART
0x40000C00 USART3 size 0xF4 — desc USART
0x40002800 I2C0 size 0x44 — desc I2C
0x40002C00 I2C1 size 0x44 — desc I2C
0x40003800 SPI0 size 0x28 — desc SPI
0x40003C00 SPI1 size 0x28 — desc SPI
0x40005000 BTIM0 size 0x76 — desc BTIM
0x40005000 GTIM0 size 0x780 — desc GTIM
0x40005100 BTIM1 size 0x76 — desc BTIM
0x40005200 BTIM2 size 0x76 — desc BTIM
0x40005400 BTIM3 size 0x76 — desc BTIM
0x40005400 GTIM1 size 0x780 — desc GTIM
0x40005500 BTIM4 size 0x76 — desc BTIM
0x40005600 BTIM5 size 0x76 — desc BTIM
0x40005800 BTIM6 size 0x76 — desc BTIM
0x40005800 GTIM2 size 0x780 — desc GTIM
0x40005900 BTIM7 size 0x76 — desc BTIM
0x40005A00 BTIM8 size 0x76 — desc BTIM
0x40006000 ATIM0MODE0 size 0x34
0x40006000 ATIM0MODE1 size 0x40
0x40006000 ATIM0MODE23 size 0x5C
0x40006C00 ATIM3MODE0 size 0x34
0x40006C00 ATIM3MODE1 size 0x40
0x40006C00 ATIM3MODE23 size 0x5C
0x40008000 CTRIM size 0x44
0x40008800 WWDT size 0xC
0x40008C80 IWDT size 0x14
0x4000A000 ADC0 size 0xD0 — desc ADC
0x4000A400 ADC1 size 0xD0 — desc ADC
0x4000A800 VC0 size 0x10 — desc VC
0x4000A810 VC1 size 0x10 — desc VC
0x4000AA00 LVD size 0xB0
0x4000B800 GPIOAUX size 0x7C
0x4000B800 SYSCTRL size 0x68
0x40020000 DMAC size 0x70
0x40020800 CRC size 0x100
0x40021400 FLASH size 0x88
0x40024000 GPIOA size 0xB0 — desc GPIO
0x40024400 GPIOB size 0xB0 — desc GPIO
0x40024800 GPIOC size 0xB0 — desc GPIO
0x40024C00 GPIOD size 0xB0 — desc GPIO

## Interrupts
0 CTRIM — CTRIM interrupt
1 VC (VC0, VC1) — VC interrupt
2 LVD — LVD interrupt
3 PORTA (GPIOA) — PORTA interrupt
4 PORTB (GPIOB) — PORTB interrupt
5 PORTC (GPIOC) — PORTC interrupt
6 PORTD (GPIOD) — PORTD interrupt
7 IWDT — IWDT interrupt
8 WWDT — WWDT interrupt
10 ADC0_ADC1 (ADC0, ADC1) — ADC0_ADC1 interrupt
11 FLASH — FLASH interrupt
12 USART0_RX (USART0) — USART0_RX interrupt
13 USART0_TX (USART0) — USART0_TX interrupt
14 USART0_FLAG (USART0) — USART0_FLAG interrupt
15 USART1_RX (USART1) — USART1_RX interrupt
16 USART1_TX (USART1) — USART1_TX interrupt
17 USART1_FLAG (USART1) — USART1_FLAG interrupt
18 USART2_RX (USART2) — USART2_RX interrupt
19 USART2_TX (USART2) — USART2_TX interrupt
20 USART2_FLAG (USART2) — USART2_FLAG interrupt
21 USART3_RX (USART3) — USART3_RX interrupt
22 USART3_TX (USART3) — USART3_TX interrupt
23 USART3_FLAG (USART3) — USART3_FLAG interrupt
24 I2C0 — I2C0 interrupt
25 I2C1 — I2C1 interrupt
26 SPI0_TX (SPI0) — SPI0_TX interrupt
27 SPI0_RX (SPI0) — SPI0_RX interrupt
28 SPI0_SSR (SPI0) — SPI0_SSR interrupt
29 SPI0_ERR (SPI0) — SPI0_ERR interrupt
30 SPI1_TX (SPI1) — SPI1_TX interrupt
31 SPI1_RX (SPI1) — SPI1_RX interrupt
32 SPI1_SSR (SPI1) — SPI1_SSR interrupt
33 SPI1_ERR (SPI1) — SPI1_ERR interrupt
34 GTIM0_UEV_ETR_BTIMA (GTIM0) — GTIM0_UEV_ETR_BTIMA interrupt
35 GTIM0_CH01_BTIMB (GTIM0) — GTIM0_CH01_BTIMB interrupt
36 GTIM0_CH23_BTIMC (GTIM0) — GTIM0_CH23_BTIMC interrupt
37 GTIM1_UEV_ETR_BTIMA (GTIM1) — GTIM1_UEV_ETR_BTIMA interrupt
38 GTIM1_CH01_BTIMB (GTIM1) — GTIM1_CH01_BTIMB interrupt
39 GTIM1_CH23_BTIMC (GTIM1) — GTIM1_CH23_BTIMC interrupt
40 GTIM2_UEV_ETR_BTIMA (GTIM2) — GTIM2_UEV_ETR_BTIMA interrupt
41 GTIM2_CH01_BTIMB (GTIM2) — GTIM2_CH01_BTIMB interrupt
42 GTIM2_CH23_BTIMC (GTIM2) — GTIM2_CH23_BTIMC interrupt
51 DMA_CH0 (DMAC) — DMA_CH0 interrupt
52 DMA_CH1 (DMAC) — DMA_CH1 interrupt
53 DMA_CH2 (DMAC) — DMA_CH2 interrupt
54 DMA_CH3 (DMAC) — DMA_CH3 interrupt
55 DMA_CH4 (DMAC) — DMA_CH4 interrupt
56 DMA_CH5 (DMAC) — DMA_CH5 interrupt
